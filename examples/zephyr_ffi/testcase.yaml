## examples/zephyr_ffi/testcase.yaml
```yaml
tests:
  tessipher.ffi:
    tags:
      - ffi
      - qr
    harness: ztest
    platform_allow:
      - mps2/an385
    integration_platforms:
      - mps2/an385
    timeout: 120
```
